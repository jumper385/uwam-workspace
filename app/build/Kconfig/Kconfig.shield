## app/build/Kconfig/Kconfig.shield
```kconfig
osource "/Users/henrychen/Documents/digism-firmware/uwam-workspace/uwam-workspace/boards/shields/*/Kconfig.shield"
```

## boards/arm/nucleo_l412kb/Kconfig.board
```kconfig
# STM32L412RB Nucleo board configuration

# Copyright (c) 2021 Guðni Már Gilbert
# SPDX-License-Identifier: Apache-2.0

config BOARD_NUCLEO_L412KB
	bool "Nucleo L412KB Development Board"
	depends on SOC_STM32L412XX
```

## boards/arm/weact_stm32h743/Kconfig.board
```kconfig
config BOARD_WEACT_STM32H743
    bool "WeAct Studio STM32H743"
    depends on SOC_STM32H743XX
```

## boards/arm/weact_stm32h743/weact_stm32h743_defconfig
```kconfig
CONFIG_SOC_SERIES_STM32H7X=y
CONFIG_SOC_STM32H743XX=y

CONFIG_SYS_CLOCK_HW_CYCLES_PER_SEC=8000000
CONFIG_INIT_PLL1=y
# Enable MPU
CONFIG_ARM_MPU=y

# Enable HW stack protection
CONFIG_HW_STACK_PROTECTION=y

# Enable UART
CONFIG_SERIAL=y

# Console
CONFIG_CONSOLE=y
CONFIG_UART_CONSOLE=y

# Enable GPIO
CONFIG_GPIO=y

# Enable clocks
CONFIG_CLOCK_CONTROL=y

# enable pin controller
CONFIG_PINCTRL=y

CONFIG_SIZE_OPTIMIZATIONS=y
```
