&can1 {
    pinctrl-0 = <&can1_tx_pa12 &can1_rx_pa11>;
    pinctrl-names = "default"; 
    status = "okay";
};

&can2 {
    pinctrl-0 = <&can2_tx_pb13 &can2_rx_pb12>;
    pinctrl-names = "default"; 
    status = "okay";
};

&usart3 {
    pinctrl-0 = <&usart3_rx_pc11 &usart3_tx_pc10>;
    pinctrl-names = "default";
    current-speed = <115200>;
    status = "okay";
};
