## boards/uwam/pdm_2024/Kconfig
```kconfig
if BOARD_PDM_2024

config SPI_STM32_INTERRUPT
	default y
	depends on SPI

endif 
```

## boards/uwam/pdm_2024/Kconfig.pdm_2024
```kconfig
# Copyright (c) 2021 Nordic Semiconductor ASA
# SPDX-License-Identifier: Apache-2.0

config BOARD_PDM_2024
	select SOC_STM32F446XX
```

## boards/uwam/pdm_2024/board.yml
```yaml
# Copyright (c) 2024 Nordic Semiconductor ASA
# SPDX-License-Identifier: Apache-2.0

board:
  name: pdm_2024
  vendor: uwam
  socs:
    - name: stm32f446xx
```
